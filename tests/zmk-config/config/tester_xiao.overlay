#include <dt-bindings/zmk/keys.h>

/*
 * The node is present in every build artifact: devicetree preprocessing
 * cannot see Kconfig symbols, so it cannot be conditionally declared here.
 * With CONFIG_ZMK_GESTURE_INPUT_PROCESSOR=n the node simply has no backing
 * driver, which is exactly the "node declared but feature disabled" case the
 * feature_disabled artifact exists to keep building.
 * The node isn't wired into any real input-listener's `input-processors`
 * chain -- like zmk-module-runtime-input-processor's own build test, this
 * simply exercises devicetree binding parsing + driver instantiation.
 */
/ {
	gesture_test_processor: gesture_test_processor {
		compatible = "zmk,input-processor-gesture";
		processor-label = "gest";
		threshold = <600>;
		reset-ms = <150>;
		cooldown-ms = <200>;
		bindings = <&kp UP>, <&kp DOWN>, <&kp LEFT>, <&kp RIGHT>;
		#input-processor-cells = <0>;
	};
};

/*
 * Note: unlike the modern zmk board layouts, v0.3-branch's seeeduino_xiao_ble
 * (sourced from the Zephyr board tree) has no `board_cdc_acm_uart` labeled
 * node -- its console runs over hardware UART0. CONFIG_CONSOLE=n in
 * tester_xiao.conf is what actually disables the console here.
 */
