## Kconfig
```kconfig
config ZMK_GESTURE_INPUT_PROCESSOR
    bool "Enable gesture input processor feature"

if ZMK_GESTURE_INPUT_PROCESSOR

config ZMK_GESTURE_INPUT_PROCESSOR_STUDIO_RPC
    bool "Enable gesture input processor custom Studio RPC"
    depends on ZMK_STUDIO

config ZMK_GESTURE_INPUT_PROCESSOR_NAME_MAX_LEN
    int "Maximum length of gesture input processor names (including NUL terminator)"
    default 8

config ZMK_GESTURE_INPUT_PROCESSOR_SETTINGS_SAVE_DEBOUNCE_MS
    int "Debounce time (ms) before gesture processor settings are saved to flash"
    default 5000
    help
      How long to wait after the last runtime change (enabled, active layers,
      threshold, reset-ms, cooldown-ms) before persisting gesture processor
      settings to flash. Deliberately much shorter than ZMK's general
      CONFIG_ZMK_SETTINGS_SAVE_DEBOUNCE (60000 ms by default), so that
      adjusting settings from the web UI and then quickly power-cycling or
      resetting the board (as is common while tuning gesture parameters)
      doesn't silently lose the change.

endif
```

## dts/bindings/input_processors/zmk,input-processor-gesture.yaml
```yaml
# Copyright (c) 2026 The ZMK Contributors
# SPDX-License-Identifier: MIT

description: |
  Gesture input processor for ZMK.

  Accumulates REL_X / REL_Y movement per axis. Once the accumulated
  |movement| on either axis exceeds `threshold`, one of the four `bindings`
  entries is invoked as a tap (press then release, `tap-ms` apart) according
  to the direction of the larger-magnitude axis, both accumulators reset,
  and `cooldown-ms` of extra movement is ignored before accumulation
  resumes.

  By default the processor is one-shot: once it fires, it disarms itself
  and won't fire again until the ball has been idle for `reset-ms` (which
  also resets the accumulators), so a trackball's mechanical inertia
  coasting past the cooldown window can't repeatedly re-trigger the same
  direction. Setting `reset-ms` to `0` disables both the idle-reset and the
  one-shot re-arm, falling back to firing every `cooldown-ms` for as long as
  the ball keeps rolling (continuous/repeat mode).

  The press/release pair is dispatched asynchronously on the system
  workqueue rather than synchronously from the input event callback, so a
  slow/blocking behavior invocation (e.g. USB HID submission) never stalls
  input event processing.

  While enabled and active for the current layer, this processor consumes
  every REL_X / REL_Y event it sees (the event never reaches processors
  later in the chain), so pointer motion / scrolling stops while a gesture
  is being recognized.

compatible: "zmk,input-processor-gesture"

include: base.yaml

properties:
  processor-label:
    type: string
    required: true
    description: |
      Short label identifying this processor instance for runtime
      configuration (custom Studio RPC / settings key). Must fit within
      CONFIG_ZMK_GESTURE_INPUT_PROCESSOR_NAME_MAX_LEN bytes, terminating NUL
      included (8 by default).

  bindings:
    type: phandle-array
    required: true
    description: |
      Exactly 4 behavior bindings, invoked as a tap when a gesture fires, in
      this fixed order: up, down, left, right.

  threshold:
    type: int
    default: 600
    description: |
      Accumulated |REL_X| or |REL_Y| movement required to fire a gesture.

  reset-ms:
    type: int
    default: 150
    description: |
      Both accumulators reset to 0 if no matching REL_X / REL_Y event
      arrives for this many milliseconds. This idle time also re-arms the
      one-shot firing mechanism: after firing, the processor won't fire
      again until the ball has been idle for this long. Set to 0 to disable
      both the idle-reset and the one-shot re-arm, i.e. fall back to
      "continuous repeat" mode where a gesture fires again every
      `cooldown-ms` for as long as the ball keeps rolling.

  cooldown-ms:
    type: int
    default: 200
    description: |
      Minimum time in milliseconds between two gesture firings. Matching
      events are still consumed (not passed through) during the cooldown,
      but are not accumulated, so the next gesture always starts from 0.

  tap-ms:
    type: int
    default: 10
    description: |
      Milliseconds between the press and release of the tap invoked when a
      gesture fires. The release is dispatched asynchronously (system
      workqueue) after this delay; no further gesture can be detected until
      the release has been invoked. Compile-time only -- not adjustable at
      runtime over the Studio RPC / web UI.

  active-layers:
    type: int
    default: 0
    description: |
      Bitmask of layer indices where the processor is active (0 = active on
      all layers). Same convention as zmk-module-runtime-input-processor:
      bit N corresponds to layer index N, and the processor is active if at
      least one of the referenced layers is currently active.

  start-enabled:
    type: boolean
    description: |
      If present, the processor starts enabled as soon as it initializes.
      If absent, it starts disabled and must be enabled at runtime (e.g. via
      the Studio Web UI) before it recognizes gestures. Named "start-enabled"
      rather than "enabled" to avoid clashing with the runtime RPC field of
      the same name.

  track-remainders:
    type: boolean
    description: |
      Standard ZMK input-processor property queried by the input-processor
      chain macros; unused by this driver since it fully consumes matching
      events rather than producing a scaled value with a remainder.

  "#input-processor-cells":
    type: int
    const: 0
```
